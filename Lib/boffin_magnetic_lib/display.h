#include <stdio.h>

void DisplaySetup()
{
    display.begin(SH1106_SWITCHCAPVCC);
    display.clearDisplay();
    display.setRotation(2);
    display.setTextColor(WHITE);
}

size_t GetLength(const __FlashStringHelper *ifsh)
{
    PGM_P p = reinterpret_cast<PGM_P>(ifsh);
    size_t n = 0;
    while (1)
    {
        unsigned char c = pgm_read_byte(p++);
        if (c == 0)
            break;
        n++;
    }
    return n;
}

void PrintCenter(const __FlashStringHelper *text, uint8_t y, uint8_t size)
{
    display.setTextSize(size);
    display.setCursor((display.width() - GetLength(text) * 6 * size) / 2, y);
    display.println(text);
}

void PrintCenter(int num, uint8_t y, uint8_t size)
{
    String text(num);
    display.setTextSize(size);
    display.setCursor((display.width() - text.length() * 6 * size) / 2, y);
    display.println(text);
}

void PrintCenter(String text, uint8_t y, uint8_t size)
{
    display.setTextSize(size);
    display.setCursor((display.width() - text.length() * 6 * size) / 2, y);
    display.println(text);
}

const uint8_t PROGMEM logo_pic[] = {
    0x00, 0x3f, 0xff, 0xff, 0xff, 0xff, 0xff, 0xff, 0xff, 0xff, 0xff, 0xff, 0xff, 0xff, 0xfc, 0x00,
    0x00, 0xff, 0xff, 0xff, 0xff, 0xff, 0xff, 0xff, 0xff, 0xff, 0xff, 0xff, 0xff, 0xff, 0xff, 0x00,
    0x03, 0xff, 0xff, 0xff, 0xff, 0xc0, 0x7f, 0xff, 0xff, 0xff, 0xff, 0xff, 0xff, 0xff, 0xff, 0xc0,
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    0x00, 0x3f, 0xff, 0xff, 0x80, 0x00, 0x00, 0x3f, 0xff, 0xff, 0xff, 0xff, 0xff, 0xff, 0xfc, 0x00};

void DrawLogo(const __FlashStringHelper *text, const uint16_t time)
{
    display.drawBitmap(0, 10, logo_pic, display.width(), 27, 1);
    PrintCenter(text, 40, 2);
    display.display();
    delay(time);
}

void DrawLogo(String text, const uint16_t time)
{
    display.drawBitmap(0, 0, logo_pic, display.width(), 27, 1);
    for (uint8_t i = 0; i < text.length(); i++)
        if (text.substring(i, i + 1) == " ")
        {
            PrintCenter(text.substring(0, i), 30, 2);
            PrintCenter(text.substring(i + 1), 48, 2);
            break;
        }
    display.display();
    delay(time);
}
void DrawGameover(const uint16_t score)
{
    if (display.getRotation() == 2)
    {
        PrintCenter(F("Game Over!"), 10, 2);
        PrintCenter(F("Score"), 40, 1);
        PrintCenter(score, 50, 1);
    }
    else if (display.getRotation() == 3)
    {
        PrintCenter(F("GAME"), 20, 2);
        PrintCenter(F("OVER"), 38, 2);
        PrintCenter(F("Score"), 60, 1);
        PrintCenter(score, 70, 1);
    }
}
